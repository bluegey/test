#include "OLED.h"
#include "mydelay.h"
#include "stdio.h"
#include "stdarg.h"


/**************************************************************************************************
 *                                          CONSTANTS
 **************************************************************************************************/
/* LCD Control lines */
//  PC_4 - OLED_DC
//  PC_5 - OLED_RES
//  ???? - OLED_CS
//  PA_15- OLED_CLK
//  PA_8 - OLED_DAT

#define FONT_CS_LOW()        	GPIO_ResetBits(GPIOA, GPIO_Pin_4)
#define FONT_CS_HIGH()       	GPIO_SetBits(GPIOA, GPIO_Pin_4)

#define OLED_CS_LOW()       	GPIO_ResetBits(GPIOC, GPIO_Pin_5)
#define OLED_CS_HIGH()      	GPIO_SetBits(GPIOC, GPIO_Pin_5)

#define OLED_DC_LOW()       	GPIO_ResetBits(GPIOC, GPIO_Pin_4)
#define OLED_DC_HIGH()      	GPIO_SetBits(GPIOC, GPIO_Pin_4)

/**************************************************************************************************
 *                                           MACROS
 **************************************************************************************************/


/**************************************************************************************************
 *                                       LOCAL VARIABLES
 **************************************************************************************************/
const unsigned char OLED_HiASCII[128][16]={
{0x00,0x00,0x00,0x00,0x00,0x00,0x00,0x00,0x00,0x00,0x00,0x00,0x00,0x00,0x00,0x00},/*" ",0*/
{0x00,0x00,0x00,0x00,0x00,0x00,0x00,0x00,0x00,0x00,0x00,0x00,0xFF,0x80,0x80,0x80},/*"",1*/
{0x00,0x00,0x00,0x00,0x00,0x00,0x00,0x00,0x80,0x80,0x80,0x80,0xFF,0x00,0x00,0x00},/*"",2*/
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{0x00,0x00,0x00,0x00,0x00,0x00,0x00,0x00,0x00,0x00,0x00,0x00,0x00,0x00,0x00,0x00},/*"",127*/
};

/**************************************************************************************************
 *                                       FUNCTIONS - API
 **************************************************************************************************/
unsigned char SPI_ReadWrite(unsigned char byte);
void OLED_Write_Data(unsigned char Data);
void OLED_Write_Command (unsigned char Data);
void OLED_ConfigIO(void);
void Set_NOP(void);

/*-=-=-=-=-=-=-=-=-=-=-=-=-=-=-=-=-=-=-=-=-=-=-=-=-=-=-=-=-=-=-=-=-=-=-=
//  Instruction Setting   指令集
//-=-=-=-=-=-=-=-=-=-=-=-=-=-=-=-=-=-=-=-=-=-=-=-=-=-=-=-=-=-=-=-=-=-=*/
void OLED_Set_Start_Column(unsigned char d)   //设置开始列
{
	OLED_Write_Command(0x00+d%16);		// Set Lower Column Start Address for Page Addressing Mode
						//   Default => 0x00
	OLED_Write_Command(0x10+d/16);		// Set Higher Column Start Address for Page Addressing Mode
						//   Default => 0x10
}

void Set_Addressing_Mode(unsigned char d)  //扫描方式
{
	OLED_Write_Command(0x20);// Set Memory Addressing Mode
	OLED_Write_Command(d);	//   Default => 0x02
						//     0x00 => Horizontal Addressing Mode
						//     0x01 => Vertical Addressing Mode
						//     0x02 => Page Addressing Mode
}

void Set_Column_Address(unsigned char a, unsigned char b)      //列地址
{
	OLED_Write_Command(0x21);		// Set Column Address
	OLED_Write_Command(a);			//   Default => 0x00 (Column Start Address)
	OLED_Write_Command(b);			//   Default => 0x7F (Column End Address)
}


void Set_Page_Address(unsigned char a, unsigned char b)     //页地址
{
	OLED_Write_Command(0x22);		// Set Page Address
	OLED_Write_Command(a);			//   Default => 0x00 (Page Start Address)
	OLED_Write_Command(b);			//   Default => 0x07 (Page End Address)
}


void Set_Start_Line(unsigned char ddd)            //起始行
{
	OLED_Write_Command(0x40|ddd);	// Set Display Start Line
					    	//   Default => 0x40 (0x00)
}


void Set_Contrast_Control(unsigned char ddd)     //对比设置
{
	OLED_Write_Command(0x81);		// Set Contrast Control
	OLED_Write_Command(ddd);			//   Default => 0x7F
}


void Set_Charge_Pump(unsigned char ddd)         //???????????????
{
	OLED_Write_Command(0x8D);	// Set Charge Pump
	OLED_Write_Command(0x10|ddd);	//   Default => 0x10
					    	//     0x10 (0x00) => Disable Charge Pump
					    	//     0x14 (0x04) => Enable Charge Pump
}


void Set_Segment_Remap(unsigned char ddd)
{
	OLED_Write_Command(0xA0|ddd);	// Set Segment Re-Map
					    	//   Default => 0xA0
						    //     0xA0 (0x00) => Column Address 0 Mapped to SEG0
						    //     0xA1 (0x01) => Column Address 0 Mapped to SEG127
}


void Set_Entire_Display(unsigned char ddd)      //全部显示
{
	OLED_Write_Command(0xA4|ddd);	// Set Entire Display On / Off
						//   Default => 0xA4
						//     0xA4 (0x00) => Normal Display
						//     0xA5 (0x01) => Entire Display On
}


void Set_Inverse_Display(unsigned char ddd)//反向显示
{
	OLED_Write_Command(0xA6|ddd);			// Set Inverse Display On/Off
						//   Default => 0xA6
						//     0xA6 (0x00) => Normal Display
						//     0xA7 (0x01) => Inverse Display On
}


void Set_Multiplex_Ratio(unsigned char ddd)         //多样比例
{
	OLED_Write_Command(0xA8);			// Set Multiplex Ratio
	OLED_Write_Command(ddd);			//   Default => 0x3F (1/64 Duty)
}


void Set_Display_On_Off(unsigned char dd)       	//显示开关
{
	OLED_Write_Command(0xAE|dd);	// Set Display On/Off
						//   Default => 0xAE
						//     0xAE (0x00) => Display Off
						//     0xAF (0x01) => Display On
}


void OLED_Set_Start_Page(unsigned char dd)            //设置起始页    用于页寻址
{
	OLED_Write_Command(0xB0|dd);			// Set Page Start Address for Page Addressing Mode
						//   Default => 0xB0 (0x00)
}


void Set_Common_Remap(unsigned char dd)
{
	OLED_Write_Command(0xC0|dd);	// Set COM Output Scan Direction
						//   Default => 0xC0
						//     0xC0 (0x00) => Scan from COM0 to 63
						//     0xC8 (0x08) => Scan from COM63 to 0
}


void Set_Display_Offset(unsigned char dd)          //补偿显示
{
	OLED_Write_Command(0xD3);		// Set Display Offset
	OLED_Write_Command(dd);			//   Default => 0x00
}


void Set_Display_Clock(unsigned char dd)        //设置显示时钟
{
	OLED_Write_Command(0xD5);		// Set Display Clock Divide Ratio / Oscillator Frequency
	OLED_Write_Command(dd);			//   Default => 0x80
						//     D[3:0] => Display Clock Divider
						//     D[7:4] => Oscillator Frequency
}


void Set_Precharge_Period(unsigned char dd)       //预充电周期
{
	OLED_Write_Command(0xD9);	// Set Pre-Charge Period
	OLED_Write_Command(dd);		//   Default => 0x22 (2 Display Clocks [Phase 2] / 2 Display Clocks [Phase 1])
						//     D[3:0] => Phase 1 Period in 1~15 Display Clocks
						//     D[7:4] => Phase 2 Period in 1~15 Display Clocks
}


void Set_Common_Config(unsigned char dd)
{
	OLED_Write_Command(0xDA);	// Set COM Pins Hardware Configuration
	OLED_Write_Command(0x02|dd);	//   Default => 0x12 (0x10)
						//     Alternative COM Pin Configuration
						//     Disable COM Left/Right Re-Map
}


void Set_VCOMH(unsigned char dd)
{
	OLED_Write_Command(0xDB);		// Set VCOMH Deselect Level
	OLED_Write_Command(dd);			//   Default => 0x20 (0.77*VCC)
}


void Set_NOP()           //无操作  停顿
{
	OLED_Write_Command(0xE3);		// Command for No Operation
}


void OLED_setXY(unsigned char X,unsigned char Y)
{

	 OLED_Set_Start_Page(Y);
	 OLED_Set_Start_Column(X);
}


/*-=-=-=-=-=-=-=-=-=-=-=-=-=-=-=-=-=-=-=-=-=-=-=-=-=-=-=-=-=-=-=-=-=-=-=
//  Show Regular Pattern (Full Screen)           正常模式显示
//-=-=-=-=-=-=-=-=-=-=-=-=-=-=-=-=-=-=-=-=-=-=-=-=-=-=-=-=-=-=-=-=-=-=*/
void OLED_Fill_RAM(unsigned char Data)     //全部显示为 Data
{
	unsigned char i,j;
	OLED_setXY(0,0);
	for(i=0;i<8;i++)
	{
		for(j=0;j<128;j++)
		{
			OLED_Write_Data(Data);
		}
	}
}

/*=-=-=-=-=-=-=-=-=-=-=-=-=-=-=-=-=-=-=-=-=-=-=-=-=-=-=-=-=-=-=-=-=-=
//  Show Regular Pattern (Partial or Full Screen)   //局部或者全部显示为 Data
//
//    a: Start Page
//    b: End Page
//    c: Start Column
//    d: Total Columns
//-=-=-=-=-=-=-=-=-=-=-=-=-=-=-=-=-=-=-=-=-=-=-=-=-=-=-=-=-=-=-=-=-=-=*/
void Fill_Block(unsigned char Data, unsigned char a, unsigned char b, unsigned char c, unsigned char d)
{
unsigned char i,j;
	
	for(i=a;i<(b+1);i++)
	{
		OLED_Set_Start_Page(i);
		OLED_Set_Start_Column(c);

		for(j=0;j<d;j++)
		{
			OLED_Write_Data(Data);
		}
	}
}


/*-=-=-=-=-=-=-=-=-=-=-=-=-=-=-=-=-=-=-=-=-=-=-=-=-=-=-=-=-=-=-=-=-=-=-=
//  Show Pattern (Partial or Full Screen)         //局部或者全部显示为 *Data_Pointer
//
//    a: Start Page
//    b: End Page
//    c: Start Column
//    d: Total Columns  总列数
//-=-=-=-=-=-=-=-=-=-=-=-=-=-=-=-=-=-=-=-=-=-=-=-=-=-=-=-=-=-=-=-=-=-=*/
void Show_Pattern(unsigned char *Data_Pointer, unsigned char a, unsigned char b, unsigned char c, unsigned char d)
{
unsigned char *Src_Pointer;
unsigned char i,j;

	Src_Pointer=Data_Pointer;
	for(i=a;i<(b+1);i++)
	{
		OLED_Set_Start_Page(i);
		OLED_Set_Start_Column(c);

		for(j=0;j<d;j++)
		{
			OLED_Write_Data(*Src_Pointer);
			Src_Pointer++;
		}
	}
}

/*-=-=-=-=-=-=-=-=-=-=-=-=-=-=-=-=-=-=-=-=-=-=-=-=-=-=-=-=-=-=-=-=-=-=-=
//  Vertical / Fade Scrolling (Partial or Full Screen)       滚动显示设置
//
//    a: Scrolling Direction
//       "0x00" (Upward)
//       "0x01" (Downward)
//    b: Set Top Fixed Area     //顶部区域设置固定
//    c: Set Vertical Scroll Area   //垂直滚动区域设置
//    d: Set Numbers of Row Scroll per Step    //设置每一步一行滚动数字
//    e: Set Time Interval between Each Scroll Step   //每一卷设定的时间间隔的步骤
//-=-=-=-=-=-=-=-=-=-=-=-=-=-=-=-=-=-=-=-=-=-=-=-=-=-=-=-=-=-=-=-=-=-=*/
void Vertical_Scroll(unsigned char a, unsigned char b, unsigned char c, unsigned char d, unsigned char e)
{
  unsigned char i,j;	

	OLED_Write_Command(0xA3);			// Set Vertical Scroll Area
	OLED_Write_Command(b);			//   Default => 0x00 (Top Fixed Area)
	OLED_Write_Command(c);			//   Default => 0x40 (Vertical Scroll Area)

	switch(a)
	{
		case 0:
			for(i=0;i<c;i+=d)
			{
				Set_Start_Line(i);
				for(j=0;j<e;j++)
				{
					;
				}
			}
			break;
		case 1:
			for(i=0;i<c;i+=d)
			{
				Set_Start_Line(c-i);
				for(j=0;j<e;j++)
				{
					;
				}
			}
			break;
	}
	Set_Start_Line(0x00);
}

/*-=-=-=-=-=-=-=-=-=-=-=-=-=-=-=-=-=-=-=-=-=-=-=-=-=-=-=-=-=-=-=-=-=-=-=
//  Continuous Horizontal Scrolling (Partial or Full Screen)    连续的水平滚动
//
//    a: Scrolling Direction         移动方向
//       "0x00" (Rightward)
//       "0x01" (Leftward)
//    b: Define Start Page Address       定义起始页地址
//    c: Define End Page Address         定义结束页地址
//    d: Set Time Interval between Each Scroll Step in Terms of Frame Frequency
//    e: Delay Time
//-=-=-=-=-=-=-=-=-=-=-=-=-=-=-=-=-=-=-=-=-=-=-=-=-=-=-=-=-=-=-=-=-=-=*/
void Horizontal_Scroll(unsigned char a, unsigned char b, unsigned char c, unsigned char dd, unsigned char ed)
{
	OLED_Write_Command(0x26|a);			// Horizontal Scroll Setup
	OLED_Write_Command(0x00);			//           => (Dummy Write for First Parameter)
	OLED_Write_Command(b);
	OLED_Write_Command(dd);
	OLED_Write_Command(c);
	OLED_Write_Command(0x2F);			// Activate Scrolling
	my_delayus(ed);
}

/*-=-=-=-=-=-=-=-=-=-=-=-=-=-=-=-=-=-=-=-=-=-=-=-=-=-=-=-=-=-=-=-=-=-=-=
//  Continuous Vertical / Horizontal / Diagonal Scrolling (Partial or Full Screen)
//
//    a: Scrolling Direction
//       "0x00" (Vertical & Rightward)
//       "0x01" (Vertical & Leftward)
//    b: Define Start Row Address (Horizontal / Diagonal Scrolling)
//    c: Define End Page Address (Horizontal / Diagonal Scrolling)
//    d: Set Top Fixed Area (Vertical Scrolling)
//    e: Set Vertical Scroll Area (Vertical Scrolling)
//    f: Set Numbers of Row Scroll per Step (Vertical / Diagonal Scrolling)
//    g: Set Time Interval between Each Scroll Step in Terms of Frame Frequency
//    h: Delay Time
//    * d+e must be less than or equal to the Multiplex Ratio...
//-=-=-=-=-=-=-=-=-=-=-=-=-=-=-=-=-=-=-=-=-=-=-=-=-=-=-=-=-=-=-=-=-=-=*/
void Continuous_Scroll(unsigned char a, unsigned char b, unsigned char c, unsigned char dd, unsigned char ed, unsigned char f, unsigned char g, unsigned char h)
{
	OLED_Write_Command(0xA3);			// Set Vertical Scroll Area
	OLED_Write_Command(dd);			//   Default => 0x00 (Top Fixed Area)
	OLED_Write_Command(ed);			//   Default => 0x40 (Vertical Scroll Area)

	OLED_Write_Command(0x29+a);			// Continuous Vertical & Horizontal Scroll Setup
	OLED_Write_Command(0x00);			//           => (Dummy Write for First Parameter)
	OLED_Write_Command(b);
	OLED_Write_Command(g);
	OLED_Write_Command(c);
	OLED_Write_Command(f);
	OLED_Write_Command(0x2F);			// Activate Scrolling
	my_delayus(h);
}

/*-=-=-=-=-=-=-=-=-=-=-=-=-=-=-=-=-=-=-=-=-=-=-=-=-=-=-=-=-=-=-=-=-=-=-=
//  Deactivate Scrolling (Full Screen)   关闭滚动
//-=-=-=-=-=-=-=-=-=-=-=-=-=-=-=-=-=-=-=-=-=-=-=-=-=-=-=-=-=-=-=-=-=-=*/
void Deactivate_Scroll()
{
	OLED_Write_Command(0x2E);			// Deactivate Scrolling
}

/*-=-=-=-=-=-=-=-=-=-=-=-=-=-=-=-=-=-=-=-=-=-=-=-=-=-=-=-=-=-=-=-=-=-=-=
//  Sleep Mode   睡眠模式
//
//    "0x00" Enter Sleep Mode   进入睡眠模式
//    "0x01" Exit Sleep Mode   退出睡眠模式
//-=-=-=-=-=-=-=-=-=-=-=-=-=-=-=-=-=-=-=-=-=-=-=-=-=-=-=-=-=-=-=-=-=-=*/
void Sleep(unsigned char a)
{
	switch(a)
	{
		case 0:
			Set_Display_On_Off(0x00);
			Set_Entire_Display(0x01);
			break;
		case 1:
			Set_Entire_Display(0x00);
			Set_Display_On_Off(0x01);
			break;
	}
}

		   			

void OLED_Clear(void)
{
	  OLED_Fill_RAM(0);
}


void OLED_Checkerboard()
{
	unsigned char i,j;

	OLED_setXY(0,0);
	for(i=0;i<8;i++)
	{
		for(j=0;j<64;j++)        //检测
		{
			OLED_Write_Data(0x55);
			OLED_Write_Data(0xAA);
		}
	}
}


/****************************************************************************************************
----------------显示X，Y坐标处的一个字符。一行可以显示16个字符。X为0到15，Y为0到3
*****************************************************************************************************
*函数名称:	OLED_Display_Char
*函数功能:	显示X，Y坐标处的一个字符(16*8)
*输入参数:	X---横坐标
*				Y---纵坐标
*				cn---字符
*输出参数:	void
*备注:		一行可以显示16个字符。X为0到120，Y为0到3
****************************************************************************************************/

void OLED_Display_Char(unsigned char x,unsigned char y,char c)	 
{
	unsigned char i;
	OLED_setXY(x,7-y);
	for(i=0;i<8;i++)
		OLED_Write_Data(*(*(OLED_HiASCII+c)+i));
	
	OLED_setXY(x,6-y);
	for(i=8;i<16;i++)
		OLED_Write_Data(*(*(OLED_HiASCII+c)+i));
}


/**************************************************************************************************
 * @fn      OLED_Display_String
 *
 * @brief   显示字符串
 *
 * @param  	GBCode  	字符串
 *          x,y		位置
 *					
 * @return  None
 **************************************************************************************************/
void OLED_Display_String(unsigned char x,unsigned char y,char* str)
{
	while(*str)
	{
		OLED_Display_Char(x,y,*str++);
		x=x+8;
	}
}


/**************************************************************************************************
 * @fn      OLED_Display_Format
 *
 * @brief   格式化输出字符串
 *
 * @param   x,y		位置
 *				format  	格式化字符
 * @return  None
 **************************************************************************************************/
void OLED_Display_Format(unsigned char x,unsigned char y,const char* format,...)
{
	va_list ap;
	char string[64]={0};
	va_start(ap,format);
	vsnprintf(string,64,format,ap);
	va_end(ap);
	OLED_Display_String(x,y,string);
}

/**************************************************************************************************
 *                                    HARDWARE LCD
 **************************************************************************************************/
void OLED_ConfigIO(void)
{
	SPI_InitTypeDef  SPI_InitStructure;
	GPIO_InitTypeDef GPIO_InitStructure;

	RCC_APB2PeriphClockCmd(RCC_APB2Periph_GPIOA|RCC_APB2Periph_GPIOC|RCC_APB2Periph_AFIO|RCC_APB2Periph_SPI1,ENABLE);

	GPIO_InitStructure.GPIO_Pin=GPIO_Pin_5|GPIO_Pin_6|GPIO_Pin_7;
	GPIO_InitStructure.GPIO_Mode=GPIO_Mode_AF_PP;
	GPIO_InitStructure.GPIO_Speed=GPIO_Speed_50MHz;
	GPIO_Init(GPIOA,&GPIO_InitStructure);

	GPIO_InitStructure.GPIO_Pin=GPIO_Pin_4|GPIO_Pin_5;
	GPIO_InitStructure.GPIO_Mode=GPIO_Mode_Out_PP;
	GPIO_Init(GPIOC,&GPIO_InitStructure);

	GPIO_InitStructure.GPIO_Pin=GPIO_Pin_4;
	GPIO_Init(GPIOA,&GPIO_InitStructure);

	OLED_CS_HIGH();
	FONT_CS_HIGH();

	SPI_InitStructure.SPI_Direction=SPI_Direction_2Lines_FullDuplex;
	SPI_InitStructure.SPI_Mode=SPI_Mode_Master;
	SPI_InitStructure.SPI_DataSize=SPI_DataSize_8b;
	SPI_InitStructure.SPI_CPOL=SPI_CPOL_High;
	SPI_InitStructure.SPI_CPHA=SPI_CPHA_2Edge;
	SPI_InitStructure.SPI_NSS=SPI_NSS_Soft;
	SPI_InitStructure.SPI_BaudRatePrescaler=SPI_BaudRatePrescaler_16;
	SPI_InitStructure.SPI_FirstBit=SPI_FirstBit_MSB;
	SPI_InitStructure.SPI_CRCPolynomial=7;
	SPI_Init(SPI1,&SPI_InitStructure);

	SPI_Cmd(SPI1,ENABLE);
}

/**************************************************************************************************
 * @fn      OLEDInit
 *
 * @brief   Initilize OLED Driver.
 *
 * @param   None
 *
 * @return  None
 **************************************************************************************************/
void OLED_Init(void)
{
	/* Initialize LCD IO lines */
	OLED_ConfigIO();
	
	Set_Display_On_Off(0x00);			// Display Off (0x00/0x01)
	Set_Display_Clock(0x80);			// Set Clock as 100 Frames/Sec
	Set_Multiplex_Ratio(0x3F);			// 1/64 Duty (0x0F~0x3F)
	Set_Display_Offset(0x00);	  		// Shift Mapping RAM Counter (0x00~0x3F)
	Set_Start_Line(0x00);		    	// Set Mapping RAM Display Start Line (0x00~0x3F)
	Set_Charge_Pump(0x04);		    	// Enable Embedded DC/DC Converter (0x00/0x04)
	Set_Addressing_Mode(0x00);		    // Set Page Addressing Mode (0x00/0x01/0x02)
	Set_Segment_Remap(0x01);		    // Set SEG/Column Mapping (0x00/0x01)
	Set_Common_Remap(0x00);		    	// Set COM/Row Scan Direction (0x00/0x08)  ////////////////
	Set_Common_Config(0x10);	    	// Set Sequential Configuration (0x00/0x10)
	Set_Contrast_Control(0xFF);	// Set SEG Output Current
	Set_Precharge_Period(0xF1);			// Set Pre-Charge as 15 Clocks & Discharge as 1 Clock
	Set_VCOMH(0x40);					// Set VCOM Deselect Level
	Set_Entire_Display(0x00);			// Disable Entire Display On (0x00/0x01)
	Set_Inverse_Display(0x00);			// Disable Inverse Display On (0x00/0x01)
	

	OLED_Fill_RAM(0x00);				    	// Clear Screen

	Set_Display_On_Off(0x01);	    	// Display On (0x00/0x01)
}


/**************************************************************************************************
 * @fn      OLED_Write_Command
 *
 * @brief   写控制命令
 *
 * @param   Data		数据
 *					
 * @return  None
 **************************************************************************************************/
void OLED_Write_Command (unsigned char Data)
{
	OLED_CS_LOW();
	OLED_DC_LOW();
	SPI_ReadWrite(Data);
	OLED_CS_HIGH();
}

/**************************************************************************************************
 * @fn      OLED_Write_Data
 *
 * @brief   写数据
 *
 * @param   Data		数据
 *					
 * @return  None
 **************************************************************************************************/
void OLED_Write_Data(unsigned char Data)
{
	OLED_CS_LOW();
	OLED_DC_HIGH();
	SPI_ReadWrite(Data);
	OLED_CS_HIGH();
}


unsigned char SPI_ReadWrite(unsigned char byte)
{
	while(SPI_I2S_GetFlagStatus(SPI1,SPI_I2S_FLAG_TXE)==RESET);
	SPI_I2S_SendData(SPI1,byte);
	while(SPI_I2S_GetFlagStatus(SPI1,SPI_I2S_FLAG_RXNE)==RESET);
	return SPI_I2S_ReceiveData(SPI1);
}
